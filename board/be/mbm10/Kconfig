## board/be/mbm10/Kconfig
```kconfig
if TARGET_BE_MBM10

config SYS_BOARD
	default "be_mbm10"

config SYS_VENDOR
	default "be"

config SYS_SOC
	default "be-soc"

config SYS_CONFIG_NAME
	default "be-mbm10"

endif
```

## configs/be_mbm10_defconfig
```kconfig
CONFIG_ARM=y
CONFIG_ARCH_K3=y
CONFIG_SPL_LIBCOMMON_SUPPORT=y
CONFIG_SPL_LIBGENERIC_SUPPORT=y
CONFIG_SYS_MALLOC_F_LEN=0x8000
CONFIG_NR_DRAM_BANKS=2

CONFIG_SPL_DMA=y
CONFIG_SPL_ENV_SUPPORT=y
CONFIG_SPL_I2C_SUPPORT=y

CONFIG_CMD_ASKENV=y
CONFIG_CMD_DFU=y
CONFIG_CMD_GPT=y
CONFIG_CMD_I2C=y
CONFIG_CMD_MMC=y
CONFIG_CMD_PCI=y
CONFIG_CMD_REMOTEPROC=y
CONFIG_CMD_USB=y

CONFIG_SPL_RAM_SUPPORT=y
CONFIG_SPL_SPI_FLASH_SFDP_SUPPORT=y
CONFIG_SPL_SPI_LOAD=y
CONFIG_SPL_USB_HOST_SUPPORT=y  
CONFIG_SPL_USB_STORAGE=y
CONFIG_SPL_USB_GADGET=y
CONFIG_SPL_DFU=y
CONFIG_SPL_YMODEM_SUPPORT=y

CONFIG_CMD_TIME=y

CONFIG_DM_I2C=y
CONFIG_I2C_SET_DEFAULT_BUS_NUM=y
CONFIG_DM_I2C_GPIO=y
CONFIG_SYS_I2C_OMAP24XX=y

CONFIG_SYS_SPI_U_BOOT_OFFS=0x280000

CONFIG_ARCH_MX6=y
CONFIG_TARGET_BE_MBM10=y
CONFIG_MXC_UART=y

CONFIG_NAND_MXS=y
CONFIG_SYSRESET=y
```
